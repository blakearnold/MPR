## drivers/mmc/Kconfig
```kconfig
#
# MMC subsystem configuration
#

menu "MMC/SD/SDIO support, can only select one arch from MMC and MSS"

menuconfig MMC
	tristate "MMC/SD card support"
	depends on HAS_IOMEM
	help
	  MMC is the "multi-media card" bus protocol.

	  If you want MMC support, you should say Y here and also
	  to the specific driver for your MMC interface.

config MMC_DEBUG
	bool "MMC debugging"
	depends on MMC != n
	help
	  This is an option for use by developers; most people should
	  say N here.  This enables MMC core and driver debugging.
if MMC

source "drivers/mmc/core/Kconfig"

source "drivers/mmc/card/Kconfig"

source "drivers/mmc/host/Kconfig"

endif # MMC

config MSS
	tristate "MSS architecture MMC/SD/SDIO Interface support"
	help
	  MSS is an advanced version of the MMC protocol drivers
	  which abstracts the control layer to encompass multiple
	  media card formats. Simply define the protocols you
	  wish to use (one is MMC for instance, another is SD).

	  If you want MSS support, you should say M here and also
	  to the specific drivers for your MSS interface.

if MSS

source "drivers/mmc/mss/Kconfig"

endif

endmenu
```

## drivers/mmc/mss/Kconfig
```kconfig
#
# MMC subsystem configuration
#

comment "MSS structure support"


config MSS_BLOCK
	tristate "MSS block device driver"
	depends on MSS && BLOCK
	default y
	help
	  Say Y here to enable the MMC block device driver support.
	  This provides a block device driver, which you can use to
	  mount the filesystem. Almost everyone wishing MMC support
	  should say Y or M here.

config MSS_SDHCI
	tristate "MSS host controller driver"
	depends on PCI && MSS 
	help
	  This select the generic Secure Digital Host Controller Interface.
	  It is used by manufacturers such as Texas Instruments(R), Ricoh(R)
	  and Toshiba(R). Most controllers found in laptops are of this type.
	  If you have a controller with this interface, say Y or M here.

	  If unsure, say N.
```
